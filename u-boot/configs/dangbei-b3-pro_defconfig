## u-boot/configs/dangbei-b3-pro_defconfig
```kconfig
CONFIG_ARM=y
CONFIG_SYS_BOARD="dangbei-b3-pro"
CONFIG_ARCH_MESON=y
CONFIG_MESON_G12A=y
CONFIG_SYS_TEXT_BASE=0x01000000
CONFIG_NR_DRAM_BANKS=1
CONFIG_SYS_LOAD_ADDR=0x1000000

# 设备树
CONFIG_DEFAULT_DEVICE_TREE="meson-g12b-dangbei-b3-pro"

# 串口调试
CONFIG_DEBUG_UART_BASE=0xff803000
CONFIG_DEBUG_UART_CLOCK=24000000
CONFIG_DEBUG_UART=y
CONFIG_DEBUG_UART_ANNOUNCE=y
CONFIG_DEBUG_UART_SKIP_INIT=y
CONFIG_MESON_SERIAL=y
CONFIG_IDENT_STRING=" dangbei-b3-pro"

# 环境变量
CONFIG_ENV_SIZE=0x2000
CONFIG_ENV_OFFSET=0x1fe000
CONFIG_ENV_IS_IN_MMC=y
CONFIG_SYS_MMC_ENV_DEV=2
CONFIG_SYS_MMC_ENV_PART=0
CONFIG_ENV_OVERWRITE=y
CONFIG_SYS_RELOC_GD_ENV_ADDR=y

# 基础设备支持
CONFIG_DM_GPIO=y
CONFIG_PINCTRL=y
CONFIG_PINCTRL_MESON_G12A=y
CONFIG_POWER_DOMAIN=y
CONFIG_MESON_EE_POWER_DOMAIN=y
CONFIG_DM_REGULATOR=y
CONFIG_DM_REGULATOR_FIXED=y
CONFIG_DM_RESET=y

# 控制与初始化
CONFIG_MISC_INIT_R=y
CONFIG_OF_CONTROL=y
CONFIG_OF_BOARD_SETUP=y
CONFIG_OF_LIBFDT_OVERLAY=y

# 命令行支持
CONFIG_CMD_GPIO=y
CONFIG_CMD_MMC=y
CONFIG_CMD_USB=y
CONFIG_CMD_USB_MASS_STORAGE=y
CONFIG_CMD_REGULATOR=y

# 网络支持
CONFIG_NET_RANDOM_ETHADDR=y
CONFIG_PHY_REALTEK=y
CONFIG_DM_ETH=y
CONFIG_DM_MDIO=y
CONFIG_DM_MDIO_MUX=y
CONFIG_ETH_DESIGNWARE_MESON8B=y
CONFIG_MDIO_MUX_MESON_G12A=y

# 存储支持
CONFIG_MMC_MESON_GX=y
CONFIG_MTD=y
CONFIG_DM_MTD=y

# USB 支持
CONFIG_USB=y
CONFIG_USB_XHCI_HCD=y
CONFIG_USB_XHCI_DWC3=y
CONFIG_USB_DWC3=y
CONFIG_USB_DWC3_MESON_G12A=y
CONFIG_USB_KEYBOARD=y
CONFIG_USB_GADGET=n
CONFIG_USB_GADGET_VENDOR_NUM=0x1b8e
CONFIG_USB_GADGET_PRODUCT_NUM=0xfada
CONFIG_USB_GADGET_UDC=n
CONFIG_USB_GADGET_UDC_CORE=n
CONFIG_USB_GADGET_DWC2_OTG=y
CONFIG_USB_GADGET_DWC2_OTG_PHY_BUS_WIDTH_8=y
CONFIG_USB_GADGET_DOWNLOAD=y

# 视频输出
CONFIG_DM_VIDEO=y
CONFIG_VIDEO_MESON=y
CONFIG_VIDEO_DT_SIMPLEFB=y
CONFIG_SPLASH_SCREEN=y
CONFIG_SPLASH_SCREEN_ALIGN=y
CONFIG_SYS_WHITE_ON_BLACK=y
CONFIG_VIDEO_BMP_RLE8=y
CONFIG_BMP_16BPP=y
CONFIG_BMP_24BPP=y
CONFIG_BMP_32BPP=y

# 安全与加密支持
CONFIG_SHA256=y
CONFIG_CRC32C=y
CONFIG_XXHASH=y
CONFIG_LZO=y
CONFIG_ZSTD=y
CONFIG_RBTREE=y

# 文件系统支持
CONFIG_CMD_EXT4_WRITE=y
CONFIG_EXT4_WRITE=y
CONFIG_FS_BTRFS=y

# ADC 支持
CONFIG_ADC=y
CONFIG_SARADC_MESON=y

# MMU 页表支持
CONFIG_ARMV8_SET_PGTABLE=y
# Meson Secure Monitor 支持
CONFIG_MESON_SM=y
```
